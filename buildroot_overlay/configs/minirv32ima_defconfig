## buildroot_overlay/configs/minirv32ima_defconfig
```kconfig
BR2_TOOLCHAIN_BUILDROOT_CXX=y
BR2_INSTALL_LIBSTDCPP=y
BR2_riscv=y
BR2_riscv_custom=y
BR2_RISCV_ISA_RVM=y
BR2_RISCV_ISA_RVA=y
BR2_RISCV_32=y
# BR2_RISCV_USE_MMU is not set
BR2_ARCH_HAS_MMU_OPTIONAL=y
BR2_PACKAGE_HOST_LINUX_HEADERS_CUSTOM_7_1=y
BR2_GLOBAL_PATCH_DIR="$(BR2_EXTERNAL)/board/mini-rv32ima/patches"
BR2_DOWNLOAD_FORCE_CHECK_HASHES=y
BR2_TARGET_ENABLE_ROOT_LOGIN=y
BR2_TARGET_GENERIC_GETTY=y
BR2_TARGET_GENERIC_REMOUNT_ROOTFS_RW=y
BR2_ROOTFS_OVERLAY="$(BR2_EXTERNAL)/board/mini-rv32ima/overlay"
BR2_LINUX_KERNEL=y
BR2_LINUX_KERNEL_CUSTOM_VERSION=y
BR2_LINUX_KERNEL_CUSTOM_VERSION_VALUE="7.1.10"
BR2_LINUX_KERNEL_USE_CUSTOM_CONFIG=y
BR2_LINUX_KERNEL_CUSTOM_CONFIG_FILE="$(BR2_EXTERNAL)/board/mini-rv32ima/linux-nommu.config"
BR2_PACKAGE_BUSYBOX_CONFIG="$(BR2_EXTERNAL)/board/mini-rv32ima/busybox.config"
BR2_PACKAGE_UCLIBC=y
BR2_UCLIBC_CONFIG="$(BR2_EXTERNAL)/board/mini-rv32ima/uclibc.config"
BR2_UCLIBC_CONFIG_FRAGMENT_FILES=""
# BR2_PACKAGE_IFUPDOWN_SCRIPTS is not set
# BR2_PACKAGE_URANDOM_SCRIPTS is not set
BR2_TARGET_ROOTFS_INITRAMFS=y
BR2_TARGET_ROOTFS_TAR=y
BR2_TARGET_ROOTFS_TAR_NONE=y
BR2_PACKAGE_HOST_DTC=y
BR2_PACKAGE_HOST_E2FSPROGS=y
BR2_GCC_VERSION_16_X=y
BR2_GCC_VERSION="16.2.1"
BR2_PACKAGE_LUA=y
BR2_PACKAGE_PROVIDES_LUAINTERPRETER="lua"
BR2_PACKAGE_LUA_5_4=y
BR2_PACKAGE_LUA_EDITING_NONE=y
BR2_PACKAGE_HAS_LUAINTERPRETER=y
BR2_PACKAGE_LUAINTERPRETER_ABI_VERSION="5.4"
BR2_PACKAGE_LUAINTERPRETER_ABI_VERSION_5_4=y
BR2_PACKAGE_NCURSES=y
BR2_PACKAGE_NCURSES_ADDITIONAL_TERMINFO=""
BR2_PACKAGE_XORCURSES=y
BR2_PACKAGE_NANO=y
BR2_PACKAGE_NANO_TINY=y
BR2_TOOLCHAIN_BUILDROOT_WCHAR=y
BR2_USE_WCHAR=y
BR2_PACKAGE_UEMACS=y
BR2_SSP_NONE=y
# BR2_SSP_REGULAR is not set
BR2_SSP_STRONG=y
# BR2_SSP_ALL is not set
```
